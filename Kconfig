## Kconfig
```kconfig
# SPDX-License-Identifier: MIT

menu "LiberArk input drivers"

config INPUT_FT6336_TOUCHPAD
    bool "FT6336 two-contact touchpad"
    default y
    depends on DT_HAS_LIBERARK_FT6336_TOUCHPAD_ENABLED
    depends on I2C && INPUT
    help
      Enable the LiberArk FT6336 driver. It emits relative pointer motion,
      one-finger left clicks, two-finger right clicks, and two-finger scroll
      events directly into Zephyr's input subsystem.

endmenu
```

## boards/shields/liberark68/Kconfig.shield
```kconfig
config SHIELD_LIBERARK68_LEFT
    def_bool $(shields_list_contains,liberark68_left)

config SHIELD_LIBERARK68_RIGHT
    def_bool $(shields_list_contains,liberark68_right)

config SHIELD_LIBERARK68_DONGLE
    def_bool $(shields_list_contains,liberark68_dongle)

if SHIELD_LIBERARK68_LEFT || SHIELD_LIBERARK68_RIGHT || SHIELD_LIBERARK68_DONGLE

config ZMK_KEYBOARD_NAME
    default "LiberArk68"

endif
```

## config/west.yml
```yaml
manifest:
  remotes:
    - name: zmkfirmware
      url-base: https://github.com/zmkfirmware
    - name: aleblazer
      url-base: https://github.com/Aleblazer
    - name: aym1607
      url-base: https://github.com/AYM1607
    - name: mctechnology17
      url-base: https://github.com/mctechnology17
  projects:
    - name: zmk
      remote: zmkfirmware
      revision: main
      import: app/west.yml
    - name: zmk-driver-azoteq-iqs5xx
      remote: aym1607
      revision: main
    - name: zmk-oled-adapter
      remote: mctechnology17
      revision: main
    # Volumetric SH1107 display module (ten stacked OLEDs on two SPI buses)
    # for the voxel dongle build. Tracks main.
    - name: zmk-voxel-display
      remote: aleblazer
      revision: main
  self:
    path: config
```

## dts/bindings/input/liberark,ft6336-touchpad.yaml
```yaml
# SPDX-License-Identifier: MIT

description: FT6336 two-contact capacitive touch controller used as a touchpad

compatible: "liberark,ft6336-touchpad"

include: i2c-device.yaml

properties:
  int-gpios:
    type: phandle-array
    required: true
    description: Active-low touch-data interrupt

  reset-gpios:
    type: phandle-array
    required: true
    description: Active-low controller reset

  invert-x:
    type: boolean
    description: Invert horizontal pointer movement after landscape rotation

  pointer-multiplier:
    type: int
    default: 5
    description: Pointer delta multiplier

  pointer-divisor:
    type: int
    default: 2
    description: Pointer delta divisor

  scroll-divisor:
    type: int
    default: 12
    description: Two-finger centroid pixels per scroll step

  tap-time-ms:
    type: int
    default: 220
    description: Maximum contact duration recognized as a tap

  tap-move-threshold:
    type: int
    default: 12
    description: Maximum movement in pixels recognized as a tap

  scroll-start-threshold:
    type: int
    default: 6
    description: Two-finger movement required before scrolling starts

  click-release-ms:
    type: int
    default: 12
    description: Duration of the generated mouse-button press
```
