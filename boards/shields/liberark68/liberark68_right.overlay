/*
 * LiberArk68 - RIGHT half (peripheral). Mirrored PCB; 10k slide fader on
 * P0.04, tagged as joystick Y so the dongle can carry both faders.
 */

#define FADER_INPUT_CODE INPUT_ABS_Y

#include "liberark68.dtsi"
#include "liberark68_kscan.dtsi"
#include "liberark68_fader.dtsi"

/*
 * Shift this side's local kscan rows (0..2) into the combined matrix
 * rows (3..5) so the right half's keys index the right slice of
 * default_transform's map.
 */
&default_transform {
    row-offset = <3>;
};

/* Forward this fader to the dongle over the split link (endpoint reg 1). */
/ {
    split_inputs {
        #address-cells = <1>;
        #size-cells = <0>;

        fader_split: fader_split@1 {
            compatible = "zmk,input-split";
            reg = <1>;
            device = <&fader>;
        };
    };
};
