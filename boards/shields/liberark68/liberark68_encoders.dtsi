/*
 * LiberArk68 - rotary encoder add-on (LEFT half only on this variant;
 * the right half's VIK header carries the Azoteq trackpad instead).
 *
 * Two EC11 encoders on the left side's VIK pins:
 *   TOP encoder    A/B = VIK-GP1 / VIK-GP2 = P1.11 / P1.12
 *   BOTTOM encoder A/B = VIK-CS  / VIK-RGB = P0.09 / P0.10
 *
 * Pins are referenced as raw &gpio0/&gpio1 rather than &xiao_d because this
 * shared file is also compiled into the nice!nano dongle (via liberark68.dtsi),
 * which has no Xiao pin nexus. Both MCUs are nRF52840, so the raw controller
 * labels resolve on every target; the nodes stay disabled except where an
 * overlay enables them.
 *
 * The push-switches are part of the key matrix (col 10/11, row 2) and live in
 * the keymap, not here. Only rotation is handled by these EC11 sensor nodes.
 *
 * Global sensor index order (= sensor-bindings order in the keymap):
 *   0 = left top, 1 = left bottom
 *
 * NOTE: P0.09 / P0.10 are the nRF52840 NFC antenna pins. The bottom encoder
 * only works with CONFIG_NFCT_PINS_AS_GPIOS=y (set in the left .conf).
 *
 * `steps`/`triggers-per-rotation` assume a common 20-detent EC11 (4 pulses per
 * detent = 80 steps, one keymap trigger per detent). Tune if rotation feels
 * too fast/slow for your specific encoder.
 */

/ {
    left_encoder_top: encoder_left_top {
        compatible = "alps,ec11";
        a-gpios = <&gpio1 11 (GPIO_ACTIVE_HIGH | GPIO_PULL_UP)>;
        b-gpios = <&gpio1 12 (GPIO_ACTIVE_HIGH | GPIO_PULL_UP)>;
        steps = <80>;
        status = "disabled";
    };

    left_encoder_bottom: encoder_left_bottom {
        compatible = "alps,ec11";
        a-gpios = <&gpio0 9 (GPIO_ACTIVE_HIGH | GPIO_PULL_UP)>;
        b-gpios = <&gpio0 10 (GPIO_ACTIVE_HIGH | GPIO_PULL_UP)>;
        steps = <80>;
        status = "disabled";
    };

    sensors: sensors {
        compatible = "zmk,keymap-sensors";
        sensors = <&left_encoder_top &left_encoder_bottom>;
        triggers-per-rotation = <20>;
    };
};
